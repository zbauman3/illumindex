## firmware/main/Kconfig.projbuild
```kconfig
menu "Wifi Config"
  config WIFI_SSID
      string "The name of the WiFi network."
  config WIFI_PWD
      string "The password of the WiFi network."
endmenu

menu "Endpoint Config"
  config ENDPOINT_STATE_URL
      string "The URL for fetching state data."
  config ENDPOINT_URL
      string "The URL for fetching data."
  config ENDPOINT_FETCH_INTERVAL_DEFAULT
      int "The number of seconds to wait between fetching."
  config ENDPOINT_TOKEN
      string "The auth token to use for hitting the endpoint."
endmenu

menu "Time Config"
  config TIMEZONE_STRING_DEFAULT
      string "The timezone string to use for the device."
endmenu
```
